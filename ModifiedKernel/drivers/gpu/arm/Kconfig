## ModifiedKernel/drivers/gpu/arm/Kconfig
```kconfig
#
# (C) COPYRIGHT 2012-2013 ARM Limited. All rights reserved.
#
# This program is free software and is provided to you under the terms of the
# GNU General Public License version 2 as published by the Free Software
# Foundation, and any use by you of this program is subject to the terms
# of such GNU licence.
#
# A copy of the licence is included with the program, and can also be obtained
# from Free Software Foundation, Inc., 51 Franklin Street, Fifth Floor,
# Boston, MA  02110-1301, USA.
#
#

menu "ARM GPU Configuration"

choice
	prompt "Mali Version Configuration"
        default MALI_VALHALL_R26P0_R if $(PLATFORM_VERSION) <= 12
        default MALI_VALHALL_R38P1 if $(PLATFORM_VERSION) >= 13
	help
	  Select the gpu support version.

config MALI_DDK_NONE
    bool "None"

config MALI_VALHALL_R26P0_R
	bool "Valhall r26p0 driver"

config MALI_VALHALL_R38P1
        bool "Valhall r38p1 driver"

endchoice

if MALI_VALHALL_R26P0_R
source "drivers/gpu/arm/bv_r26p0/Kconfig"
endif

if MALI_VALHALL_R38P1
source "drivers/gpu/arm/bv_r38p1/Kconfig"
endif


endmenu
```

## ModifiedKernel/drivers/staging/lpd/Kconfig
```kconfig
# drivers/staging/lpd/Kconfig
#
# Copyright (c) 2010-2011 Samsung Electronics Co., Ltd.
#		http://www.samsung.com/
#
# Licensed under GPLv2

config EXYNOS_LPD
	tristate "Samsung Exynos Low Power Display"
	default N
	help
	  Enable support for Exynos Low Power Display mode.

config EXYNOS_LPD_MEM
	tristate "Samsung Exynos Low Power Display"
	depends on EXYNOS_LPD
	default m
	help
	  Enable support for Exynos Low Power Display mode.

config LPD_AUTO_BR
	tristate "Support Auto Brightness in LPD mode"
	depends on EXYNOS_LPD
	default N
	help
	  Enable support auto brightness in lpd mode.

config LPD_UPDATE_META
	tristate "Support instantly meta update"
	depends on EXYNOS_LPD
	default N

config LPD_OLED_COMPENSATION
	tristate "Support oled deburnin"
	depends on EXYNOS_LPD
	default N
```
